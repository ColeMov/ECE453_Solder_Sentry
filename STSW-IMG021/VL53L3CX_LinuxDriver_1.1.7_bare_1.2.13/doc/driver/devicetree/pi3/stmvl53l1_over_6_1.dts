/dts-v1/;
/plugin/;

/ {
    compatible = "brcm,bcm2708";

    fragment@0 {
        target = <&i2c1>;

        __overlay__ {
            #address-cells = <0x1>;
            #size-cells = <0x0>;

            stmvl53l1: stmvl53l1@29 {
                compatible = "st,stmvl53l1";
                reg = <0x29>;
                xsdn-gpio = <0x213>;
                pwren-gpio = <0x20c>;
                intr-gpio = <0x210>;
            };
        };
    };
};